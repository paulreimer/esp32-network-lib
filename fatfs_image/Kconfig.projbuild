## fatfs_image/Kconfig.projbuild
```kconfig
menu "FATFS Partition Image Configuration"

config FATFS_PARTITION_BASE_ADDR
  hex "FATFS partition base address"
  range 100000 33546240
  default 110000
  help
    Starting address of the FATFS partition

config FATFS_PARTITION_SIZE
  int "FATFS partition size in bytes"
  range 131072 16777216
  default 131072
  help
    Total size of the FATFS parition in bytes

endmenu
```

## firmware_update/Kconfig.projbuild
```kconfig
menu "Firmware Update / OTA Configuration"

config FIRMWARE_UPDATE_RECOVERY_URL
  string "Firmware Recovery URL"
  default "https://..."
  help
    HTTP(S) URL for "recovery" firmware image.
    Expects response containing image bin.

config FIRMWARE_UPDATE_LATEST_URL
  string "Firmware Update Latest Version URL"
  default "https://..."
  help
    HTTP(S) URL for "latest" firmware image.
    Expects response containing image bin.

config FIRMWARE_UPDATE_CHECK_URL
  string "Firmware Update Check URL"
  default "https://..."
  help
    HTTP(s) URL for firmware update checks.
    Expects response containing firmware flatbuffer.

config FIRMWARE_UPDATE_CHECK_INTERVAL_SECONDS
  int "Firmware Update Check Interval (seconds)"
  range 1 1209600
  default 60
  help
    Number of seconds to wait between firmware update checks.

config FIRMWARE_UPDATE_GDRIVE_FOLDER_ID
  string "Firmware Update Google Drive Folder ID"
  default ""
  help
    Google Drive Folder ID that holds the per-device config files.

endmenu
```

## module_manager/Kconfig.projbuild
```kconfig
menu "esp32-network-lib Module Manager"

config CONFIG_MODULE_MANAGER_GENERATE_SYMBOLS_C
    bool "Enable generation of symbols.c"
    help
       Select this option to enable support for loading ELF executables
       dynamically from file or memory buffer. Generates a list of all symbols
       in the last-known-good binary image, updates/embeds it in future builds.

endmenu
```

## mqtt_client/Kconfig.projbuild
```kconfig
menu "MQTT Client Configuration"

config MQTT
  bool "MQTT Enabled"
  default y

config MQTT_HOST
  string "MQTT Hostname/IP address"
  depends on MQTT
  default "mqtt.googleapis.com"

config MQTT_PORT
  int "MQTT port"
  depends on MQTT
  default 443

config MQTT_CLIENT_ID
  string "MQTT Client ID"
  depends on MQTT
  default "projects/{project-id}/locations/{cloud-region}/registries/{registry-id}/devices/{device-id}"

config MQTT_CLIENT_USERNAME
  string "MQTT Client Username"
  depends on MQTT
  default "unused"

config MQTT_CLIENT_PASSWORD
  string "MQTT Client Password"
  depends on MQTT
  default ""

config MQTT_CLIENT_CERTIFICATE_PATH
  string "Client Certificate Path"
  depends on MQTT
  default "/spiflash/mqtt_client_certificate.pem"

config MQTT_CLIENT_PRIVATE_KEY_PATH
  string "Client Private Key Path"
  depends on MQTT
  default "/spiflash/mqtt_client_private_key.pem"

config MQTT_ROOT_CERTIFICATE_PATH
  string "Root/CA Certificate Path"
  depends on MQTT
  default "/spiflash/mqtt_root_certificate.pem"

config MQTT_INITIAL_SUBSCRIPTION_TOPIC
  string "Initial MQTT Subscription Topic"
  depends on MQTT
  default "/devices/<device_id>/config"

endmenu
```

## network_manager/Kconfig.projbuild
```kconfig
menu "Wifi Configuration"

config WIFI_SSID
    string "Wifi SSID"
	default "myssid"
	help
		SSID (network name) for the example to connect to.

config WIFI_PASSWORD
    string "Wifi Password"
	default "myssid"
	help
		WiFi password (WPA or WPA2) for the example to use.

		Can be left blank if the network has no security set.

config MDNS_HOSTNAME
    string "mDNS Hostname"
	default "esp32-mdns"
	help
		mDNS Hostname when publishing services

		Typically, the .local domain will be appended to this name
		for clients to connect to.

config MDNS_INSTANCE
    string "mDNS Instance Name"
	default "ESP32 with mDNS"
	help
		mDNS Instance Name when publishing services

endmenu
```

## statsd/Kconfig.projbuild
```kconfig
menu "StatsD Configuration"

config STATSD_SERVER_IP
  string "StatsD Server IP"
  default "127.0.0.1"
  help
    StatsD Server IP for uploading metrics to.

config STATSD_SERVER_PORT
  int "StatsD Server Port"
  default "8125"
  help
    StatsD port to connect to.
    Should be chosen not to conflict with any other port used
    on the system.

config STATSD_MAX_PKTSIZE
  int "StatsD max packet size"
  default "512"
  help
    Aggregate metrics until this packet size is reached,
    or no more metrics can be added within it.
    Send the packet at the point this condition is reached,
    then reset the buffer and begin collecting again.
endmenu
```
